## src/drivers/optical_flow/tcflow/Kconfig
```kconfig
menuconfig DRIVERS_OPTICAL_FLOW_TCFLOW
	bool "tcflow"
	default n
	---help---
		Enable support for tcflow
```

## src/drivers/tcio/Kconfig
```kconfig
menuconfig DRIVERS_TCIO
	bool "tcio"
	default n
	---help---
		Enable support for tcio
```

## src/examples/tc_mavlink_debug/Kconfig
```kconfig
menuconfig EXAMPLES_TC_MAVLINK_DEBUG
	bool "tc_mavlink_debug"
	default n
	---help---
		Enable support for tc_mavlink_debug
```

## src/examples/tc_simple_app/Kconfig
```kconfig
menuconfig EXAMPLES_TC_SIMPLE_APP
	bool "tc_simple_app"
	default n
	---help---
		Enable support for tc_simple_app
```

## src/modules/sb_commander/Kconfig
```kconfig
menuconfig MODULES_SB_COMMANDER
	bool "sb_commander"
	default n
	---help---
		Enable support for sb_commander
```

## src/modules/tciofirmware/Kconfig
```kconfig
menuconfig MODULES_TCIOFIRMWARE
	bool "tciofirmware"
	default n
	---help---
		Enable support for tciofirmware
```
